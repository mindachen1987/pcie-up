## drivers/pci/controller/plda/Kconfig
```kconfig
# SPDX-License-Identifier: GPL-2.0

menu "PLDA PCIe controllers support"
	depends on PCI

config PCIE_PLDA_HOST
	bool
	depends on OF && PCI_MSI
	select IRQ_DOMAIN
	select PCIE_PLDA

config PCIE_PLDA_PLAT_HOST
	tristate "PLDA PCIe platform host controller"
	select PCIE_PLDA_HOST
	help
	  Say Y here if you want to support the PLDA PCIe platform controller in
	  host mode. This PCIe controller may be embedded into many different
	  vendors SoCs.

endmenu
```
